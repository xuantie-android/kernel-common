## Documentation/devicetree/bindings/input/touchscreen/samsung,s6d6ft0.yaml
```yaml
# SPDX-License-Identifier: (GPL-2.0-only OR BSD-2-Clause)
%YAML 1.2
---
$id: http://devicetree.org/schemas/input/touchscreen/samsung,s6d6ft0.yaml#
$schema: http://devicetree.org/meta-schemas/core.yaml#

title: Samsung S6D6FT0 integrated touch controller

maintainers:
  - LoveSy <shana@zju.edu.cn>

description: |
  Samsung S6D6FT0 touch controller integrated into TL060FVXS07 panels.
  The controller uses eight-byte coordinate events over I2C. Panel power
  and reset are shared with the display and are managed by the board's
  display integration, not independently toggled by this touch driver.

allOf:
  - $ref: touchscreen.yaml#

properties:
  compatible:
    const: samsung,s6d6ft0
  reg:
    maxItems: 1
  interrupts:
    maxItems: 1
  irq-gpios:
    maxItems: 1
    description: Active-low interrupt pin, configured as input only.

required:
  - compatible
  - reg
  - interrupts
  - touchscreen-size-x
  - touchscreen-size-y

unevaluatedProperties: false

examples:
  - |
    #include <dt-bindings/interrupt-controller/irq.h>
    #include <dt-bindings/gpio/gpio.h>
    i2c {
        #address-cells = <1>;
        #size-cells = <0>;
        touchscreen@48 {
            compatible = "samsung,s6d6ft0";
            reg = <0x48>;
            interrupt-parent = <&gpio>;
            interrupts = <3 IRQ_TYPE_LEVEL_LOW>;
            irq-gpios = <&gpio 3 GPIO_ACTIVE_LOW>;
            touchscreen-size-x = <1080>;
            touchscreen-size-y = <2160>;
        };
    };
```

## drivers/clk/thead/Kconfig
```kconfig
#SPDX-License-Identifier: GPL-2.0

config CLK_THEAD_TH1520_AP
	bool "T-HEAD TH1520 AP clock support"
	depends on ARCH_THEAD || COMPILE_TEST
	depends on 64BIT
	default ARCH_THEAD
	select REGMAP_MMIO
	help
	  Say yes here to support the AP sub system clock controller
	  on the T-HEAD TH1520 SoC. This includes configuration of
	  both CPU PLLs, both DPU PLLs as well as the GMAC, VIDEO,
	  and TEE PLLs.

config CLK_THEAD_TH1520_VPSYS
	bool "T-HEAD TH1520 video-processing gate clocks"
	depends on ARCH_THEAD || COMPILE_TEST
	depends on COMMON_CLK
	default ARCH_THEAD
	help
	  Register the ACLK, CCLK and PCLK gates used by the TH1520 video
	  encoder. The parent VENC clock is provided by the AP clock controller.
```

## drivers/net/wireless/aic8800/Kconfig
```kconfig
config AIC_WLAN_SUPPORT
	tristate "AIC SDIO bus and firmware support"
	depends on MMC && CFG80211
	default n
	help
	  Bus and firmware-loader support for AIC8800-family SDIO devices.

config AIC_FW_PATH
	depends on AIC_WLAN_SUPPORT
	string "Firmware & config file path"
	default "/lib/firmware/aic8800_fw/SDIO"
	help
	  Path to the firmware & config file.

if AIC_WLAN_SUPPORT
source "drivers/net/wireless/aic8800/aic8800_fdrv/Kconfig"
endif
```

## drivers/net/wireless/aic8800/aic8800_fdrv/Kconfig
```kconfig
config AIC8800_WLAN_SUPPORT
	tristate "AIC8800 wlan Support"
	depends on AIC_WLAN_SUPPORT
	help
	  FullMAC cfg80211 driver for AIC8800-family SDIO devices.
```

## sound/soc/xuantie/Kconfig
```kconfig
# SPDX-License-Identifier: GPL-2.0-only
config SND_SOC_XUANTIE
	tristate "ASoC support for XuanTie SoCs"
	depends on ARCH_THEAD || COMPILE_TEST
	help
	  Say Y or M to enable XuanTie SoC audio interfaces.

config SND_SOC_XUANTIE_TH1520_I2S
	tristate "XuanTie TH1520 2-channel I2S support"
	depends on SND_SOC_XUANTIE
	select SND_SOC_GENERIC_DMAENGINE_PCM
	help
	  Enable the TH1520 two-channel I2S CPU DAI.

config SND_SOC_XUANTIE_TH1520_HDMI_PCM
	tristate "XuanTie TH1520 HDMI PCM support"
	depends on SND_SOC_XUANTIE
	help
	  Enable the TH1520 HDMI PCM codec used by the AP I2S interface.
```
